## conf/machine/senorfy-raspberrypi3.conf
```bitbake
require conf/machine/raspberrypi3.conf

KBUILD_DEFCONFIG_senorfy-raspberrypi3 ?= "bcm2709_defconfig"
#IMAGE_FSTYPES = "ext4.xz rpi-sdimg"
#SDIMG_ROOTFS_TYPE="ext4.xz"

## enable uart
ENABLE_UART="1"

## packages
IMAGE_INSTALL:append = " openssh-sftp-server sudo python3 python3-pip rpi-gpio raspi-gpio"
IMAGE_FEATURES:append = " ssh-server-openssh"

## systemd settings
DISTRO_FEATURES:append = " systemd"
VIRTUAL-RUNTIME_init_manager = "systemd"
DISTRO_FEATURES_BACKFILL_CONSIDERED:append = " sysvinit"
VIRTUAL-RUNTIME_initscripts = "systemd-compat-units"
```
